## boards/shields/newton/Kconfig.defconfig
```kconfig
config SPI
    default y 

if SHIELD_NEWTON_LEFT
# Name must be less than 16 characters long!
config ZMK_KEYBOARD_NAME
    default "Newton1"

config ZMK_SPLIT_ROLE_CENTRAL
    default y

endif # SHIELD_NEWTON_LEFT

if SHIELD_NEWTON_LEFT || SHIELD_NEWTON_RIGHT

config ZMK_SPLIT
    default y

endif # SHIELD_NEWTON_LEFT || SHIELD_NEWTON_RIGHT

if ZMK_BACKLIGHT

config PWM
    default y

config LED_PWM
    default y

endif # ZMK_BACKLIGHT

if ZMK_DISPLAY

config SSD1306
    default y

config I2C
    default y

endif # ZMK_DISPLAY

if LVGL

config LV_Z_VDB_SIZE
    default 64

config LV_DPI_DEF
    default 148

config LV_Z_BITS_PER_PIXEL
    default 1

choice LV_COLOR_DEPTH
    default LV_COLOR_DEPTH_1
endchoice

endif # LVGL
```

## boards/shields/newton/Kconfig.shield
```kconfig
# Copyright (c) 2024 Lynnlee
# SPDX-License-Identifier: MIT

config SHIELD_NEWTON_LEFT
def_bool $(shields_list_contains,newton_left)

config SHIELD_NEWTON_RIGHT
def_bool $(shields_list_contains,newton_right)
```

## config/west.yml
```yaml
manifest:
  remotes:
    - name: zmkfirmware
      url-base: https://github.com/voidyourwarranty2
    # Additional modules containing boards/shields/custom code can be listed here as well
    # See https://docs.zephyrproject.org/3.2.0/develop/west/manifest.html#projects
    - name: cirque-input-module
      url-base: https://github.com/petejohanson

  projects:
    - name: zmk
      remote: zmkfirmware
      revision: devel-cirque
      import: app/west.yml
    - name: cirque-input-module
      remote: cirque-input-module
      revision: main
  self:
    path: config
```
